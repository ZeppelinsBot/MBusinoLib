/*
# Example for MBusinoLib

https://github.com/Zeppelin500/MBusinoLib/

## Licence
****************************************************
This program is free software: you can redistribute it and/or modify it under the terms of the GNU General Public License as published by
the Free Software Foundation, either version 3 of the License, or (at your option) any later version. This program is distributed in the hope that it will be useful,
but WITHOUT ANY WARRANTY; without even the implied warranty of MERCHANTABILITY or FITNESS FOR A PARTICULAR PURPOSE.  See the GNU General Public License for more details.
You should have received a copy of the GNU General Public License along with this program.  If not, see <http://www.gnu.org/licenses/>.
****************************************************
*/

#include <MBusinoLib.h>  // Library for decode M-Bus
#include <ArduinoJson.h> // is used to transfer the decoded recordings

#define START_ADDRESS 0x13  // Start address for decoding
unsigned long timerMbus = 5000;

void setup() {
Serial.begin(9600);
}


void loop() {
 
  if(millis() - timerMbus > 5000){
    timerMbus = millis();

    // M-Bus Telegram of a Sensostar U
    //byte mbus_data[] = {0x68,0x92,0x92,0x68,0x08,0x01,0x72,0x36,0x01,0x45,0x25,0x94,0x15,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0x49,0x16};
    byte mbus_data[] = {0x68,0xC4,0xC4,0x68,0x08,0x14,0x72,0x72,0x91,0x07,0x29,0x47,0x5F,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0xFB,0x16};

    int packet_size = mbus_data[1] + 6; 

// Header
    MBusinoLib payload(254); 
    // 1. Prepare JSON for Header
    StaticJsonDocument<512> headerDoc;
    JsonObject headerObj = headerDoc.to<JsonObject>();

    // 2. Decode the header (rxBuffer is your raw telegram)
    if (payload.decodeHeaderLong(mbus_data, packet_size, headerObj)) {

        Serial.println(F("--- M-Bus Header Data (Individual Fields) ---"));

        const char* meterId = headerObj["id"].as<const char*>();
        const char* manufacturer = headerObj["manufacturer"].as<const char*>();
        const char* mediumName = headerObj["medium"].as<const char*>();
        int statusCode = headerObj["status"].as<int>();
        int version = headerObj["version"].as<int>();
        int accessCounter = headerObj["access_counter"].as<int>();

        // Print to Serial
        Serial.print(F("Header JSON: "));
        serializeJson(headerDoc, Serial); 
        Serial.println(); // New line for better readability

        Serial.print(F("ID:             ")); Serial.println(meterId);
        Serial.print(F("Manufacturer:   ")); Serial.println(manufacturer);
        Serial.print(F("Medium:         ")); Serial.println(mediumName);
        Serial.print(F("Status Byte:    ")); Serial.print("0x"); Serial.println(statusCode, HEX);
        Serial.print(F("Version:        ")); Serial.println(version);
        Serial.print(F("Access Counter: ")); Serial.println(accessCounter);

        // Accessing nested status details
        bool battLow = headerObj["status_details"]["battery_low"].as<bool>();
        bool tempErr = headerObj["status_details"]["temporary_error"].as<bool>();
        bool permErr = headerObj["status_details"]["permanent_error"].as<bool>();

        Serial.print(F("Battery Low:    ")); Serial.println(battLow ? "YES" : "NO");
        Serial.print(F("Temporary Err:  ")); Serial.println(tempErr ? "YES" : "NO");
        Serial.print(F("Permanent Err:  ")); Serial.println(permErr ? "YES" : "NO");

        
        Serial.println(F("------------------------------------------"));

    } else {
        Serial.println(F("Error: Could not decode Long Frame Header."));
    }


// Payload
 
    JsonDocument jsonBuffer;
    JsonArray root = jsonBuffer.add<JsonArray>();  
    uint8_t fields = payload.decode(&mbus_data[START_ADDRESS], packet_size - START_ADDRESS - 2, root); 
    char jsonstring[4092] = { 0 };
    uint8_t address = mbus_data[5]; 
    serializeJson(root, jsonstring);

    Serial.println("###################### new message ###################### "); 
    Serial.println(String("error = " + String(payload.getError())).c_str()); 
    Serial.println(String("jsonstring = " + String(jsonstring)).c_str());  
    Serial.println(String("SlaveAddress = " + String(address)).c_str());      
    
    for (uint8_t i=0; i<fields; i++) {
      uint8_t code = root[i]["code"].as<int>();
      const char* name = root[i]["name"];
      const char* units = root[i]["units"];           
      double value = root[i]["value_scaled"].as<double>(); 
      const char* valueString = root[i]["value_string"];       

      //values comes as number or as ASCII string or both
      if(valueString != NULL){  // send the value if a ascii value is aviable (variable length)
        Serial.println(String(String(i+1) + "_vs_" + String(name)+ " = " + String(valueString)).c_str()); 
      }

      Serial.println(String(String(i+1) + "_" + String(name) + " = " + String(value,3)).c_str()); //send the value if a real value is aviable (standard)
            
      if(units != NULL){ // send the unit if is aviable
        Serial.println(String(String(i+1) + "_" + String(name) +"_unit = " + String(units)).c_str());
      }
    }
    Serial.println("###################### end of message ###################### ");      
  }
}
